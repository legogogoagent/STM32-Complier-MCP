## ESP32_STM32_Bridge/esp-idf-project/sdkconfig.defaults
```kconfig
# SDK Config Defaults for ESP32C3 Super Mini

# ESP32C3 Specific
CONFIG_IDF_TARGET="esp32c3"
CONFIG_ESPTOOLPY_FLASHSIZE_4MB=y
CONFIG_ESPTOOLPY_FLASHFREQ_80M=y
CONFIG_ESPTOOLPY_FLASHMODE_DIO=y

# FreeRTOS
CONFIG_FREERTOS_HZ=1000

# Log Level (Info by default)
CONFIG_LOG_DEFAULT_LEVEL=3

# Partition Table
CONFIG_PARTITION_TABLE_CUSTOM=y
CONFIG_PARTITION_TABLE_CUSTOM_FILENAME="partitions.csv"
CONFIG_PARTITION_TABLE_FILENAME="partitions.csv"

# HTTP Server
CONFIG_HTTPD_MAX_REQ_HDR_LEN=1024
CONFIG_HTTPD_MAX_URI_LEN=1024

# WiFi
CONFIG_ESP_WIFI_AUTH_WPA_WPA2_PSK=y

# Common
CONFIG_COMPILER_OPTIMIZATION_PERF=y
```
